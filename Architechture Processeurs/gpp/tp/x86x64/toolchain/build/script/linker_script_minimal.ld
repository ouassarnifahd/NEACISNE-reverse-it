OUTPUT_FORMAT("elf32-i386")
OUTPUT_ARCH(i386)
ENTRY(_start)

SECTIONS
{
    . = SEGMENT_START("text-segment", 0x400000) + SIZEOF_HEADERS;
	/* definition of typical sections for user application */ 
	.text :
    {
        *(.text)
    }
    .rodata : 
	{ 
        *(.rodata) 
    }
    .data :
    {
        *(.data)
    }
    .bss :
    {
        *(.bss)
    }
    /DISCARD/ : 
	{ 
	/* this sections are generated by compiler before assembling */
        *(.comment)
        *(.note.GNU-stack)
        *(.eh_frame)
    }
}
